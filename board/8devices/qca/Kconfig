## board/8devices/qca/Kconfig
```kconfig
if TARGET_8DEV_RAMBUTAN

config SYS_BOARD
	default "8devices/qca"

config SYS_SOC
	default "qca955x"

config SYS_CONFIG_NAME
	default "qca955x-rambutan"

endif

if TARGET_8DEV_RAMBUTAN_SPI

config SYS_BOARD
	default "8devices/qca"

config SYS_SOC
	default "qca955x"

config SYS_CONFIG_NAME
	default "qca955x-rambutan-spi"

endif
```

## configs/rambutan_defconfig
```kconfig
CONFIG_MIPS=y
CONFIG_TARGET_8DEV_RAMBUTAN=y
CONFIG_HUSH_PARSER=y
CONFIG_SYS_PROMPT="ath> "
CONFIG_CMD_MEMTEST=y
CONFIG_CMD_NAND=y
# CONFIG_CMD_FPGA is not set
CONFIG_CMD_TFTPPUT=y
CONFIG_CMD_DHCP=y
CONFIG_CMD_PING=y
CONFIG_CMD_USB=y
CONFIG_USB=y
CONFIG_USB_EHCI_HCD=y
CONFIG_USB_STORAGE=y
```
